## firmware/components/audio/Kconfig
```kconfig
menu "Skwoop wake word"

    config SKWOOP_WAKE_KEYWORD
        string "Preferred WakeNet keyword (model wn9_<keyword> in the model partition)"
        default "heyskwoop"
        help
            Put the trained model under models/wakenet/wn9_<keyword>/; the build
            packs it into the model partition. Missing model: "Hi ESP" is used.

endmenu
```

## firmware/components/clipcache/Kconfig
```kconfig
menu "Skwoop clip cache"

    config SKWOOP_CLIP_CACHE_KB
        int "Clip cache cap on the storage partition (KB)"
        range 64 12288
        default 4096

endmenu
```

## firmware/components/cloud/Kconfig
```kconfig
menu "Skwoop direct cloud (standalone)"
    depends on SKWOOP_STANDALONE

    config SKWOOP_CLOUD_STT_BASE
        string "STT base URL (OpenAI-compatible, POST {base}/audio/transcriptions)"
        default "https://api.openai.com/v1"

    config SKWOOP_CLOUD_STT_MODEL
        string "STT model"
        default "whisper-1"

    config SKWOOP_CLOUD_STT_KEY
        string "Key slot in encrypted NVS for STT"
        default "openai"

    config SKWOOP_CLOUD_LLM_BASE
        string "Chat base URL (OpenAI-compatible); the stored provider base overrides it"
        default "https://api.openai.com/v1"

    config SKWOOP_CLOUD_LLM_MODEL
        string "Chat model"
        default "gpt-4o-mini"
        help
            Sent as "model" on the chat call. The default is gpt-4o-mini.

    config SKWOOP_CLOUD_LLM_KEY
        string "Key slot in encrypted NVS for chat"
        default "openai"

    choice SKWOOP_CLOUD_TTS
        prompt "TTS provider"
        default SKWOOP_CLOUD_TTS_OPENAI

        config SKWOOP_CLOUD_TTS_OPENAI
            bool "OpenAI-compatible /audio/speech (pcm 24 kHz)"

        config SKWOOP_CLOUD_TTS_ELEVENLABS
            bool "ElevenLabs /v1/text-to-speech (pcm_24000)"
    endchoice

    config SKWOOP_CLOUD_TTS_BASE
        string "TTS base URL"
        default "https://api.elevenlabs.io" if SKWOOP_CLOUD_TTS_ELEVENLABS
        default "https://api.openai.com/v1"

    config SKWOOP_CLOUD_TTS_MODEL
        string "TTS model"
        default "eleven_flash_v2_5" if SKWOOP_CLOUD_TTS_ELEVENLABS
        default "tts-1"
        help
            OpenAI speech model for POST /audio/speech. tts-1 is a documented
            Audio API id (tts-1-hd is the higher-quality option). ElevenLabs
            uses its own model id when that provider is selected.

    config SKWOOP_CLOUD_TTS_VOICE
        string "TTS voice"
        default "your-voice-id" if SKWOOP_CLOUD_TTS_ELEVENLABS
        default "alloy"
        help
            OpenAI-compatible voices use a public name such as alloy.
            For ElevenLabs this is a voice id. The default is a placeholder;
            set yours in menuconfig. Do not commit a real voice id.

    config SKWOOP_CLOUD_TTS_KEY
        string "Key slot in encrypted NVS for TTS"
        default "elevenlabs" if SKWOOP_CLOUD_TTS_ELEVENLABS
        default "openai"

endmenu
```

## firmware/components/mqtt_lite/Kconfig
```kconfig
menu "Skwoop smart home (MQTT)"

    config SKWOOP_MQTT_URL
        string "Broker URL (mqtt://host[:port] or mqtts://host[:port]); empty disables MQTT"
        default ""

    config SKWOOP_MQTT_USER
        string "Broker username (password: key slot \"mqtt\" in encrypted NVS)"
        default ""

    config SKWOOP_LIGHTS_TOPIC
        string "Topic for the light commands (payload ON / OFF)"
        default "skwoop/lights/set"

endmenu
```

## firmware/components/skwoop/Kconfig
```kconfig
menu "Skwoop"

    config SKWOOP_STANDALONE
        bool "Skwoop standalone modules (harness, BM25 memory, clips)"
        default n

    config SKWOOP_BRIDGE_HOST
        string "Bridge host"
        default "bridge.example"
        help
            Hostname of the bridge host. The pod requests
            http://<host>:<port>/xiaozhi/ota/. Example value; set the
            real host in menuconfig.

    config SKWOOP_BRIDGE_PORT
        int "Bridge port"
        range 1 65535
        default 8003
        help
            TCP port of the bridge host. Example value.

    config SKWOOP_AP_SSID_PREFIX
        string "Provisioning AP SSID prefix"
        default "skwoop"
        help
            While provisioning, the softAP name is "<prefix>-" plus the
            last two MAC bytes (for example skwoop-1a2b). Keep the prefix
            at most 26 characters. Example only, not a home network name.

    comment "Mood weights are optional. If components/mood/mood_v11.bin is missing, mood is disabled. Generate it with tools/export_mood.py."

endmenu
```

## firmware/components/timers/Kconfig
```kconfig
menu "Skwoop timers"

    config SKWOOP_TZ
        string "POSIX TZ for alarms and the clock"
        default "CST6CDT,M3.2.0,M11.1.0"

endmenu
```

## firmware/sdkconfig.defaults
```kconfig
CONFIG_IDF_TARGET="esp32s3"
CONFIG_COMPILER_OPTIMIZATION_SIZE=y
CONFIG_ESPTOOLPY_FLASHMODE_QIO=y
CONFIG_ESPTOOLPY_FLASHFREQ_80M=y
CONFIG_ESPTOOLPY_FLASHSIZE_32MB=y
CONFIG_PARTITION_TABLE_CUSTOM=y
CONFIG_PARTITION_TABLE_CUSTOM_FILENAME="partitions.csv"
CONFIG_PARTITION_TABLE_OFFSET=0x9000
CONFIG_SPIRAM=y
CONFIG_SPIRAM_MODE_OCT=y
CONFIG_SPIRAM_SPEED_80M=y
CONFIG_CODEC_I2C_BACKWARD_COMPATIBLE=n
CONFIG_CODEC_ES8311_SUPPORT=y
CONFIG_CODEC_ES7210_SUPPORT=y
CONFIG_CODEC_ES7243_SUPPORT=n
CONFIG_CODEC_ES7243E_SUPPORT=n
CONFIG_CODEC_ES8156_SUPPORT=n
CONFIG_CODEC_AW88298_SUPPORT=n
CONFIG_CODEC_ES8389_SUPPORT=n
CONFIG_CODEC_ES8374_SUPPORT=n
CONFIG_CODEC_ES8388_SUPPORT=n
CONFIG_CODEC_TAS5805M_SUPPORT=n
CONFIG_SECURE_FLASH_ENC_ENABLED=y
CONFIG_SECURE_FLASH_ENCRYPTION_MODE_DEVELOPMENT=y
CONFIG_NVS_ENCRYPTION=y
CONFIG_FATFS_LFN_HEAP=y
CONFIG_MBEDTLS_GCM_C=y
CONFIG_SR_WN_WN9_HIESP=y
CONFIG_SR_MN_EN_MULTINET7_QUANT=y
CONFIG_SR_MN_CN_NONE=y
CONFIG_SKWOOP_STANDALONE=y

# f6 trim: wifi
CONFIG_ESP_WIFI_ENTERPRISE_SUPPORT=n
CONFIG_ESP_WIFI_SOFTAP_SAE_SUPPORT=n
CONFIG_ESP_WIFI_ENABLE_WPA3_OWE_STA=n
CONFIG_ESP_WIFI_GMAC_SUPPORT=n
CONFIG_ESP_WIFI_ENABLE_SAE_PK=n
CONFIG_ESP_WIFI_WPS_SOFTAP_REGISTRAR=n
CONFIG_ESP_WIFI_SOFTAP_BEACON_MAX_LEN=752
CONFIG_ESP_WIFI_MBEDTLS_TLS_CLIENT=n

# f6 trim: lwip
CONFIG_LWIP_IPV6=n
CONFIG_LWIP_PPP_SUPPORT=n
CONFIG_LWIP_SLIP_SUPPORT=n
CONFIG_LWIP_IP_FORWARD=n
CONFIG_LWIP_IPV4_NAPT=n
CONFIG_LWIP_NETIF_LOOPBACK=n
CONFIG_LWIP_TCP_SND_BUF_DEFAULT=5760
CONFIG_LWIP_TCP_WND_DEFAULT=5760
CONFIG_LWIP_TCP_RECVMBOX_SIZE=6
CONFIG_LWIP_UDP_RECVMBOX_SIZE=6
CONFIG_LWIP_TCPIP_RECVMBOX_SIZE=16
CONFIG_LWIP_MAX_SOCKETS=8

# f6 trim: mbedtls
CONFIG_MBEDTLS_SSL_PROTO_TLS1_3=n
CONFIG_MBEDTLS_KEY_EXCHANGE_RSA=n
CONFIG_MBEDTLS_KEY_EXCHANGE_DHE_RSA=n
CONFIG_MBEDTLS_KEY_EXCHANGE_ECDH_ECDSA=n
CONFIG_MBEDTLS_KEY_EXCHANGE_ECDH_RSA=n
CONFIG_MBEDTLS_CCM_C=n
CONFIG_MBEDTLS_CHACHAPOLY_C=n
CONFIG_MBEDTLS_CAMELLIA_C=n
CONFIG_MBEDTLS_DES_C=n
CONFIG_MBEDTLS_BLOWFISH_C=n
CONFIG_MBEDTLS_XTEA_C=n
CONFIG_MBEDTLS_ARIA_C=n
CONFIG_MBEDTLS_CIPHER_MODE_CFB=n
CONFIG_MBEDTLS_CIPHER_MODE_OFB=n
CONFIG_MBEDTLS_SSL_RENEGOTIATION=n
CONFIG_MBEDTLS_ECP_DP_SECP192R1_ENABLED=n
CONFIG_MBEDTLS_ECP_DP_SECP224R1_ENABLED=n
CONFIG_MBEDTLS_ECP_DP_SECP521R1_ENABLED=n
CONFIG_MBEDTLS_ECP_DP_SECP192K1_ENABLED=n
CONFIG_MBEDTLS_ECP_DP_SECP224K1_ENABLED=n
CONFIG_MBEDTLS_ECP_DP_SECP256K1_ENABLED=n
CONFIG_MBEDTLS_ECP_DP_BP256R1_ENABLED=n
CONFIG_MBEDTLS_ECP_DP_BP384R1_ENABLED=n
CONFIG_MBEDTLS_ECP_DP_BP512R1_ENABLED=n
CONFIG_MBEDTLS_PEM_WRITE_C=n
CONFIG_MBEDTLS_X509_CSR_PARSE_C=n
CONFIG_MBEDTLS_X509_CRL_PARSE_C=n
CONFIG_MBEDTLS_RIPEMD160_C=n

# f6 trim: certs
CONFIG_MBEDTLS_CERTIFICATE_BUNDLE_DEFAULT_NONE=y
CONFIG_MBEDTLS_CUSTOM_CERTIFICATE_BUNDLE=y
CONFIG_MBEDTLS_CUSTOM_CERTIFICATE_BUNDLE_PATH="skwoop_roots.pem"

# f6 trim: log
CONFIG_LOG_DEFAULT_LEVEL_ERROR=y
CONFIG_LOG_MAXIMUM_LEVEL_ERROR=y
CONFIG_BOOTLOADER_LOG_LEVEL_WARN=y
CONFIG_COMPILER_OPTIMIZATION_ASSERTIONS_SILENT=y
CONFIG_HAL_ASSERTION_SILENT=y
CONFIG_LWIP_ESP_LWIP_ASSERT=n

# f6 trim: opus

# g6: timer countdown font
CONFIG_LV_FONT_MONTSERRAT_40=y
```
